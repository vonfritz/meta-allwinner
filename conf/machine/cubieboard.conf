## conf/machine/cubieboard.conf
```bitbake
#@TYPE: Machine
#@NAME: CubieBoard
#@DESCRIPTION: Machine configuration for the cubieboard, based on allwinner a10 CPU http://cubieboard.org/

# Only has DVI connector for external screen
GUI_MACHINE_CLASS = "bigscreen"

require conf/machine/include/tune-cortexa8.inc
require conf/machine/include/sunxi.inc
require conf/machine/include/sunxi-mali.inc

UBOOT_MACHINE = "cubieboard"

MACHINE_FEATURES = "kernel26 screen apm usbgadget usbhost vfat alsa"
```

## conf/machine/cubieboard2.conf
```bitbake
#@TYPE: Machine
#@NAME: CubieBoard2
#@DESCRIPTION: Machine configuration for the cubieboard2, based on allwinner A20 CPU http://cubieboard.org/

# Only has DVI connector for external screen
GUI_MACHINE_CLASS = "bigscreen"

require conf/machine/include/tune-cortexa7.inc
require conf/machine/include/sunxi.inc
require conf/machine/include/sunxi-mali.inc

PREFERRED_VERSION_linux-sunxi_cubieboard2 = "3.4.75-git"

UBOOT_MACHINE = "cubieboard2"

MACHINE_FEATURES = "screen apm usbgadget usbhost vfat"
```

## conf/machine/cubietruck.conf
```bitbake
#@TYPE: Machine
#@NAME: Cubietruck
#@DESCRIPTION: Machine configuration for the Cubietruck, based on allwinner A20 CPU http://cubieboard.org/

# Only has DVI connector for external screen
GUI_MACHINE_CLASS = "bigscreen"

require conf/machine/include/tune-cortexa7.inc
require conf/machine/include/sunxi.inc
require conf/machine/include/sunxi-mali.inc

UBOOT_MACHINE = "cubietruck"

MACHINE_FEATURES = "screen apm usbgadget usbhost vfat"
```

## conf/machine/include/sunxi.inc
```bitbake
PREFERRED_PROVIDER_virtual/xserver = "xserver-xorg"
XSERVER = "xserver-xorg \
           xf86-video-fbturbo \
           xf86-input-evdev \
           xf86-input-mouse \
           xf86-input-keyboard"

PREFERRED_PROVIDER_virtual/kernel = "linux-sunxi"
PREFERRED_VERSION_linux-libc-headers = "3.4.75"

KERNEL_IMAGETYPE = "uImage"

UBOOT_ENTRYPOINT = "0x40008000"
UBOOT_LOADADDRESS = "0x40008000"

SERIAL_CONSOLE = "115200 ttyS0"

IMAGE_CLASSES += "sdcard_image-sunxi"
IMAGE_FSTYPES += "ext3 tar.gz sunxi-sdimg"
```

## conf/machine/mele.conf
```bitbake
#@TYPE: Machine
#@NAME: Mele a1000/a2000
#@DESCRIPTION: Machine configuration for the Mele a1000 and a2000, base on allwinner a10 CPU

# Only has DVI connector for external screen
GUI_MACHINE_CLASS = "bigscreen"

require conf/machine/include/tune-cortexa8.inc
require conf/machine/include/sunxi.inc
require conf/machine/include/sunxi-mali.inc

UBOOT_MACHINE = "Mele_A1000_config"

MACHINE_FEATURES = "kernel26 screen apm usbgadget usbhost vfat alsa"
```

## conf/machine/meleg.conf
```bitbake
#@TYPE: Machine
#@NAME: Mele a1000g/a2000g
#@DESCRIPTION: Machine configuration for the Mele a1000g and a2000g, base on allwinner a10 CPU

# Only has DVI connector for external screen
GUI_MACHINE_CLASS = "bigscreen"

require conf/machine/include/tune-cortexa8.inc
require conf/machine/include/sunxi.inc
require conf/machine/include/sunxi-mali.inc

UBOOT_MACHINE = "mele_a1000g"

MACHINE_FEATURES = "kernel26 screen apm usbgadget usbhost vfat alsa"
```

## conf/machine/olinuxino-a10s.conf
```bitbake
#@TYPE: Machine
#@NAME: Olimex A10S-OLinuXino-MICRO Board
#@DESCRIPTION: Machine configuration for Olimex A10S-OLinuXino-MICRO Board, based on Allwinner A10s CPU
#https://github.com/OLIMEX/OLINUXINO

# There are also LCD possibilities
GUI_MACHINE_CLASS = "bigscreen"

require conf/machine/include/tune-cortexa8.inc
require conf/machine/include/sunxi.inc

UBOOT_MACHINE = "A10s-OLinuXino-M_config"

MACHINE_FEATURES = "kernel26 screen apm usbgadget usbhost vfat alsa"
```

## conf/machine/olinuxino-a13.conf
```bitbake
#@TYPE: Machine
#@NAME: Olimex A13-OLinuXino Board
#@DESCRIPTION: Machine configuration for the Olime A13-OLinuXino Board, base on allwinner a13 CPU
#https://github.com/OLIMEX/OLINUXINO

# Only has DVI connector for external screen
GUI_MACHINE_CLASS = "bigscreen"

require conf/machine/include/tune-cortexa8.inc
require conf/machine/include/sunxi.inc
require conf/machine/include/sunxi-mali.inc

UBOOT_MACHINE = "A13-OLinuXino_config"

MACHINE_FEATURES = "kernel26 screen apm usbgadget usbhost vfat alsa"
```

## conf/machine/olinuxino-a20.conf
```bitbake
#@TYPE: Machine
#@NAME: Olimex A20-OLinuXino Board
#@DESCRIPTION: Machine configuration for the Olimex A20-OLinuXino Board, based on Allwinner A20 CPU
#https://github.com/OLIMEX/OLINUXINO

require conf/machine/include/tune-cortexa7.inc
require conf/machine/include/sunxi.inc
require conf/machine/include/sunxi-mali.inc

UBOOT_MACHINE = "A20-OLinuXino_MICRO_config"

MACHINE_FEATURES = "kernel26 screen apm usbgadget usbhost vfat alsa"
```
